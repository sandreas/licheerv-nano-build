## buildroot-external-licheervnano/configs/licheervnano_defconfig
```kconfig
# Target toolchain
BR2_riscv=y
BR2_RISCV_64=y
BR2_TOOLCHAIN_BUILDROOT_MUSL=y
BR2_TOOLCHAIN_HEADERS_CUSTOM=n

# Linux kernel

# Root filesystem
BR2_TARGET_ROOTFS_EXT2=y
BR2_TARGET_ROOTFS_EXT2_4=y
BR2_ROOTFS_OVERLAY="$(BR2_EXTERNAL_LICHERVNANO_PATH)/board/licheervnano/rootfs_overlay"
BR2_ROOTFS_POST_BUILD_SCRIPT="$(BR2_EXTERNAL_LICHERVNANO_PATH)/board/licheervnano/post-build.sh"
BR2_ROOTFS_POST_IMAGE_SCRIPT="$(BR2_EXTERNAL_LICHERVNANO_PATH)/board/licheervnano/post-image.sh"

# U-Boot
BR2_TARGET_UBOOT=y
BR2_TARGET_UBOOT_BUILD_SYSTEM_KCONFIG=y
BR2_TARGET_UBOOT_BOARD_DEFCONFIG="licheerv_nano"
# use upstream uboot
BR2_TARGET_UBOOT_CUSTOM_GIT=y
BR2_TARGET_UBOOT_CUSTOM_REPO_URL="https://github.com/u-boot/u-boot.git"
BR2_TARGET_UBOOT_CUSTOM_REPO_VERSION="v2024.10"

# opensbi
BR2_TARGET_OPENSBI=y
BR2_TARGET_OPENSBI_PLATFORM_GENERIC=y


# Linux kernel
BR2_LINUX_KERNEL=y
BR2_LINUX_KERNEL_CUSTOM_GIT=y
BR2_LINUX_KERNEL_CUSTOM_REPO_URL="https://github.com/torvalds/linux.git"
BR2_LINUX_KERNEL_CUSTOM_REPO_VERSION="v6.19"

BR2_LINUX_KERNEL_USE_CUSTOM_CONFIG=y
BR2_LINUX_KERNEL_CUSTOM_CONFIG_FILE="$(BR2_EXTERNAL_LICHERVNANO_PATH)/board/licheervnano/linux.config"

BR2_LINUX_KERNEL_IMAGE=y

BR2_PACKAGE_HOST_GENIMAGE=y
```
